## sdkconfig.defaults
```kconfig
#
# Serial flasher config
#
CONFIG_ESPTOOLPY_FLASHMODE_QIO=y
CONFIG_ESPTOOLPY_FLASHSIZE_4MB=y

#
# Compiler options
#
CONFIG_COMPILER_OPTIMIZATION_PERF=y

#
# UART configuration
#
CONFIG_UART_ISR_IN_IRAM=y

#
# ESP system settings
#
CONFIG_ESP_CONSOLE_USB_SERIAL_JTAG=y

#
# FreeRTOS
#
CONFIG_FREERTOS_USE_TRACE_FACILITY=y

#
# Partition table
#
CONFIG_PARTITION_TABLE_CUSTOM=y
CONFIG_PARTITION_TABLE_CUSTOM_FILENAME="partitions.csv"
CONFIG_PARTITION_TABLE_FILENAME="partitions.csv"

#
# SPIFFS configuration
#
CONFIG_SPIFFS_MAX_PARTITIONS=1
CONFIG_SPIFFS_PAGE_SIZE=512

#
# LVGL configuration
#
CONFIG_LV_COLOR_16_SWAP=y
CONFIG_LV_DISP_DEF_REFR_PERIOD=20
CONFIG_LV_USE_PERF_MONITOR=y
CONFIG_LV_PERF_MONITOR_ALIGN_BOTTOM_RIGHT=y
CONFIG_LV_USE_MEM_MONITOR=y
CONFIG_LV_MEM_MONITOR_ALIGN_BOTTOM_LEFT=y
# CONFIG_LV_BUILD_EXAMPLES is not set

#
# LVGL ESP drivers
#
CONFIG_LV_TFT_DISPLAY_USER_CONTROLLER_ST7789=y
CONFIG_LV_TFT_DISPLAY_SPI_FULL_DUPLEX=y
CONFIG_LV_TFT_USE_CUSTOM_SPI_CLK_DIVIDER=y
CONFIG_LV_TFT_SPI_CLK_DIVIDER_2=y
CONFIG_LV_DISP_SPI_MOSI=7
CONFIG_LV_DISP_SPI_CLK=6
# CONFIG_LV_DISPLAY_USE_SPI_CS is not set
CONFIG_LV_DISP_PIN_DC=8
CONFIG_LV_DISP_PIN_RST=9
CONFIG_LV_DISP_BACKLIGHT_OFF=y
```
